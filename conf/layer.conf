## conf/layer.conf
```bitbake
# We have a conf and classes directory, add to BBPATH
BBPATH .= ":${LAYERDIR}"

# We have recipes-* directories, add to BBFILES
BBFILES += "${LAYERDIR}/recipes-*/*/*.bb \
	${LAYERDIR}/recipes-*/*/*.bbappend"

BBFILE_COLLECTIONS += "upmpdcli-layer"
BBFILE_PATTERN_upmpdcli-layer = "^${LAYERDIR}/"
BBFILE_PRIORITY_upmpdcli-layer = "6"

# This should only be incremented on significant changes that will
# cause compatibility issues with other layers
LAYERVERSION_upmpdcli-layer = "1"

LAYERDEPENDS_upmpdcli-layer = "core openembedded-layer"

LAYERSERIES_COMPAT_upmpdcli-layer = " hardknott"
```
